## conf/layer.conf
```bitbake
BBPATH .= ":${LAYERDIR}"
BBFILES += " \
    ${LAYERDIR}/recipes-*/*/*.bb \
    ${LAYERDIR}/recipes-*/*/*.bbappend \
"

BBFILE_COLLECTIONS += "tegra-signing-server"
BBFILE_PATTERN_tegra-signing-server = "^${LAYERDIR}/"
BBFILE_PRIORITY_tegra-signing-server = "20"

LAYERVERSION_tegra-signing-server = "1"
LAYERDEPENDS_tegra-signing-server = "tegra"
LAYERSERIES_COMPAT_tegra-signing-server = "kirkstone"
```
